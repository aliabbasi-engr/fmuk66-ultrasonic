## px4_application/drive_motors_rc/Kconfig
```kconfig
menuconfig EXAMPLES_DRIVE_MOTORS_RC
	bool "drive_motors_rc"
	default n
	---help---
		Enable support for drive_motors_rc
```

## px4_application/print_distance_ultrasonic/Kconfig
```kconfig
menuconfig EXAMPLES_PRINT_DISTANCE_ULTRASONIC
	bool "print_distance_ultrasonic"
	default n
	---help---
		Enable support for print_distance_ultrasonic
```
